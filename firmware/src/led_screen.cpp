#include "led_screen.hpp"
#include <cstring>



 void SD1306::writeCommand(uint8_t cmnd)
 {
    uint8_t data_pack = {0x00 , cmd};
    i2c_read_dt(&dev_i2c,packet,2);
 }

 void SD1306::writeData(uint8_t* data,size_t len)
 {
    uint8_t data_pack = {0x00 , data};
    i2c_burst_write_dt(&dev_i2c, 0x40, data, len);
 }

 void SD1306::clear()
{
    memset(buffer, 0, sizeof(buffer));
}

void SD1306::update()
{
    writeData(buffer, sizeof(buffer));
}

  bool SD1306::init()
  {

      if (!i2c_is_ready_dt(&dev_i2c)) {
        return false; 
    }
   
    writeCommand(0xAE); //Display OFF

    writeCommand(0xD5); // Ustawienie zegara 
    writeCommand(0x80); // Domyślna wartość

    writeCommand(0xA8); // rozdzielczość
    writeCommand(0x3F); //

    writeCommand(0xD3); // Przesunięcie ekranu 
    writeCommand(0x00); // Brak przesunięcia

    writeCommand(0x40); // Ustawienie linii startowej na 0

    writeCommand(0x8D); // Charge Pump
    writeCommand(0x14); // 

    writeCommand(0x20); // Tryb adresowania pamięci 
    writeCommand(0x00); // 0x00 = Horizontal Addressing Mode 
    writeCommand(0xA1); // Odwrócenie osi X 
    writeCommand(0xC8); // Odwrócenie osi Y 
    writeCommand(0xDA); // Konfiguracja pinów 
    writeCommand(0x12); // 128x64

    writeCommand(0x81); // Ustawienie kontrastu
    writeCommand(0xCF); 

    writeCommand(0xD9); // Okres ładowania 
    writeCommand(0xF1);

    writeCommand(0xDB); //  VCOMH
    writeCommand(0x40);

    writeCommand(0xA4); // Używaj zawartości RAMdwyświetlania obrazu
    writeCommand(0xA6); // Normalny tryb wyświetlania 

    // 3. Wyczyszczenie bufora i wysłanie go do ekranu,
    clear();
    update();

    // 4. Finalne włączenie matrycy
    writeCommand(0xAF); // Włącz ekran (Display ON)
    
}

 void SD1306::drawPixel(int x, int y, bool color)
 {

    if (x < 0 || x >= 128 || y < 0 || y >= 64) {
        return; 
    }
    int index = x + (y / 8) * 128;
        
    uint8_t bit = y % 8;

    // 4. Modulo na bitach
    if (color) {
        buffer[index] |= (1 << bit);  
    } else {
        buffer[index] &= ~(1 << bit); 
}

const uint8_t font5x7[][5] = {
    {0x00, 0x00, 0x00, 0x00, 0x00}, // 32: Spacja
    {0x00, 0x00, 0x5F, 0x00, 0x00}, // 33: !
    {0x00, 0x07, 0x00, 0x07, 0x00}, // 34: "
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    {0x61, 0x51, 0x49, 0x45, 0x43}  // 90: Z
};
    
}
void SD1306::drawstring(int x,int y, char* str)
{
    int current_x = x;
    while(*str != "\0")
    {
        char c = *str;
    }
    if(c >= 32 || c<=90)
    {
        int font_ind = c -32;

        for(int col =0;col<5;col++)
        {
            uint8_t col_data = font5x7[font_ind][col];
            
            for(int row=0; row <8; row++)
            {
                if(col_data & (1<<row)) // kolor
                {
                    drawPixel(current_x + col,y+row,true);
                }
                else
                {
                    drawPixel(current_x+ col, y+ row,false);
                }
            }
            current_x + 6; // 5 przesunieca(liczba) + 1( na odstep);

            str++
        }
    }
    //iteruje sie bo string wyciagajac chara
 //dopoki w char nie dojde do konca 
 // biore chara i odejmuje od niego 32 zagladam do tablicy 
 // petla w petli x piec razy i wypisuje w kadym przebiegu y jak wypisze juz do konca znak to dodaje do x +1zeby zrobic odstep
}


void SSD1306::drawBitmap(int x, int y, int w, int h, const uint8_t* bitmap) {
   
    int byte_width = (w + 7) / 8; 
    
    for (int row = 0; row < h; row++) {
        for (int col = 0; col < w; col++) {
            
            uint8_t data = bitmap[row * byte_width + (col / 8)];
         
            if (data & (1 << (7 - (col % 8)))) {
                drawPixel(x + col, y + row, true);
            } else {
              
                drawPixel(x + col, y + row, false); 
            }
        }
    }
}
void SSD1306::fillRectangle(int x,int y,int length,int width)
{
    

    for(int col = 0; col < length; col++)
    {
        
    }
}
